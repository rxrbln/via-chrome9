## linux/drivers/gpu/drm/chrome9/Kconfig
```kconfig
# SPDX-License-Identifier: GPL-2.0-only

config DRM_CHROME9
	tristate "VIA Chrome9 HD (VX900) DRM driver"
	depends on DRM && PCI
	select DRM_CLIENT_SELECTION
	select DRM_EXEC
	select DRM_GEM_DMA_HELPER
	select DRM_GEM_SHMEM_HELPER
	select DRM_KMS_HELPER
	help
	  Clean-room DRM render and native IGA1 modesetting driver for the VIA
	  VX900 Chrome9 HD graphics function (PCI ID 1106:7122).

	  The KMS path owns the VGA output, exposes DRM fbdev emulation for the
	  console, and shares one DRM device with Mesa/Xorg glamor. Rendering remains
	  behind explicit bring-up gates; no raw userspace command stream is
	  accepted. Loading it also requires the chrome9_enable=1 module parameter.

	  If M is selected, the module will be called chrome9.
```
